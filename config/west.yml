## config/west.yml
```yaml
manifest:
  remotes:
    - name: zmkfirmware
      url-base: https://github.com/zmkfirmware
    - name: halfdane
      url-base: https://github.com/halfdane
    - name: oleksandrmaslov
      url-base: https://github.com/oleksandrmaslov
  projects:
    - name: zmk
      remote: zmkfirmware
      revision: v0.3
      import: app/west.yml
    - name: zmk-input-gestures
      remote: halfdane
      revision: main
    - name: zmk-input-processors
      remote: halfdane
      revision: main
    - name: cirque-input-module
      remote: halfdane
      revision: absolute_mode
    - name: zmk-pointing-acceleration
      remote: oleksandrmaslov
      revision: fixed
  self:
    path: config
```
